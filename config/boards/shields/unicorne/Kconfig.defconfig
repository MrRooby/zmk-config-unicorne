## config/boards/shields/unicorne/Kconfig.defconfig
```kconfig
if SHIELD_UNICORNE_LEFT

  # Name must be less than 16 characters long!
  config ZMK_KEYBOARD_NAME
      default "uniCorne"

  config ZMK_SPLIT_ROLE_CENTRAL
      default y

endif

if SHIELD_UNICORNE_LEFT || SHIELD_UNICORNE_RIGHT

  config ZMK_SPLIT
      default y

  config ZMK_DISPLAY
      default y
endif
```

## config/boards/shields/unicorne/Kconfig.shield
```kconfig
# No whitespace after the comma or in your part name!
config SHIELD_UNICORNE_LEFT
    def_bool $(shields_list_contains,unicorne_left)

# No whitespace after the comma or in your part name!
config SHIELD_UNICORNE_RIGHT
    def_bool $(shields_list_contains,unicorne_right)
```
